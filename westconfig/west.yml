## westconfig/west.yml
```yaml
# https://docs.zephyrproject.org/latest/develop/west/manifest.html
manifest:
  remotes:
    - name: xmos
      url-base: git@github.com:xmos

    - name: xalbertoisorna
      url-base: https://github.com/xalbertoisorna/
      
  projects:
    - name: xmos_cmake_toolchain # fork
      remote : xalbertoisorna
      path: xmos_cmake_toolchain
      revision: main
      clone-depth : 1

    - name : lib_i2c # fork
      remote : xalbertoisorna
      path: modules/i2c
      revision: develop
      submodules: true
      import : true
    
    - name : lib_mipi # fork
      remote : xalbertoisorna
      path: modules/mipi
      submodules: true
      revision: develop     

    - name : fwk_core
      remote : xmos
      path: modules/core
      revision: develop
      submodules: true
      clone-depth : 1

 

    
```
